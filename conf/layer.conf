## conf/layer.conf
```bitbake
# We have a conf and classes directory, add to BBPATH
BBPATH .= ":${LAYERDIR}"

# We have recipes-* directories, add to BBFILES
BBFILES += "${LAYERDIR}/recipes-*/*/*.bb \
            ${LAYERDIR}/recipes-*/*/*.bbappend"

BBFILE_COLLECTIONS += "bgn-essa"
BBFILE_PATTERN_bgn-essa = "^${LAYERDIR}/"
BBFILE_PRIORITY_bgn-essa = "60"

# Additional HAB information is provided by printing HAB FIT information
IMXBOOT_TARGETS:append = " print_fit_hab"

IMAGE_INSTALL:append = " \
    libgcc \
    udev \
    lvm2 \
    e2fsprogs-mke2fs \
    coreutils \
    keyutils \
    util-linux \
    cryptodev-module \
    cryptsetup \
    sys-setup \
    caam-keygen \
    lrzsz \
"

# Changing the WKS file to add DM partition
WKS_FILE:imx8mmevk = "imx-bootpart-dm-mx8mm.wks.in"
WKS_FILE:imx6sxsabresd = "${@bb.utils.contains('ESSA_BOOT_MEDIUM', 'QSPI', 'essa-qspi-boot-dm-mx6sx.wks.in', 'essa-bootpart-dm-mx6sx.wks.in', d)}"
WKS_FILE:imx6ulevk = "imx-bootpart-dm-mx6ul.wks.in"

# TODO: Present in UEI version of meta layer
# IMAGE_OVERHEAD_FACTOR = "${@bb.utils.contains('TEST_BUILD', '1', '1.1', '1.3', d)}"
# WKS_FILE = "${@bb.utils.contains('TEST_BUILD', '1', 'test-essa-qspi-boot-dm.wks.in', 'essa-qspi-boot-dm.wks.in', d)}"

# TODO: UEI also adds 'uei-arm' to LAYERDEPENDS
LAYERDEPENDS_bgn-essa = "core"
LAYERSERIES_COMPAT_bgn-essa = "honister"
```
